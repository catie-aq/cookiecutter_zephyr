/*
 * Copyright (c) {{cookiecutter.copyright_year}}, {{cookiecutter.copyright_holder}}
 * SPDX-License-Identifier: Apache-2.0
 */

#include <zephyr/dt-bindings/gpio/sixtron-header.h>

/* Defines every peripheral used by the shield */
#define PERIPHERAL_{{cookiecutter.__board_name_macro}}(port) 0

/* Declare each drivers */
#define DRIVERS_{{cookiecutter.__board_name_macro}}(port, port) 0

/* Defines aliases for each previously declared drivers */
#define ALIASES_{{cookiecutter.__board_name_macro}}(port) \
    / { \
        aliases { \
        }; \
    };

/* Execute macro in the right order */
#define {{cookiecutter.__board_name_macro}}(port) \
    PERIPHERAL_{{cookiecutter.__board_name_macro}}(port) \
    DRIVERS_{{cookiecutter.__board_name_macro}}(port) \
    ALIASES_{{cookiecutter.__board_name_macro}}(port)
