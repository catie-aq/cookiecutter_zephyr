## CMakeLists.txt
```
# Copyright (c) {{cookiecutter.copyright_year}} {{cookiecutter.copyright_holder}}
# SPDX-License-Identifier: Apache-2.0

cmake_minimum_required(VERSION 3.13.1)

{% if cookiecutter.secure_app|lower == "true" -%}
set(SHIELD zest_security_secureelement)
{% endif -%}

find_package(Zephyr REQUIRED HINTS $ENV{ZEPHYR_BASE})

project({{cookiecutter.application|lower|replace(' ','_')}} LANGUAGES C)

file(GLOB_RECURSE app_sources src/*.c)
target_sources(app PRIVATE ${app_sources})
```

## prj.conf
```kconfig
# Copyright (c) {{cookiecutter.copyright_year}} {{cookiecutter.copyright_holder}}
# SPDX-License-Identifier: Apache-2.0
{% if cookiecutter.secure_app|lower == "true" -%}
CONFIG_GPIO=y
CONFIG_I2C=y

CONFIG_MAIN_STACK_SIZE=4096

CONFIG_LIB_STSELIB=y
{% endif -%}
```

## app.overlay
```dts
/*
 * Copyright (c) {{cookiecutter.copyright_year}}, {{cookiecutter.copyright_holder}}
 *
 * SPDX-License-Identifier: Apache-2.0
 */

#include <zephyr/dt-bindings/gpio/sixtron-header.h>
{%- if cookiecutter.secure_app|lower == "true" %}
ZEST_SECURITY_SECUREELEMENT(1)
{%- endif %}
```

## src/main.c
```c
/*
 * Copyright (c) {{cookiecutter.copyright_year}}, {{cookiecutter.copyright_holder}}
 * SPDX-License-Identifier: Apache-2.0
 */

#include <zephyr/kernel.h>
{%- if cookiecutter.secure_app|lower == "true" %}
#include <zephyr/device.h>
#include <zephyr/drivers/gpio.h>

#include "stselib.h"
{%- endif %}

int main(void)
{
{%- if cookiecutter.secure_app|lower == "true" %}
	int ret = STSE_OK;
	stse_Handler_t stse_handler;
	ret = stse_set_default_handler_value(&stse_handler);
	if (ret != STSE_OK) {
		printk("Failed to set default handler value: %d\n", ret);
		return -1;
	}

#ifdef CONFIG_STSAFE_A110
	stse_handler.device_type = STSAFE_A110;
#elif defined(CONFIG_STSAFE_A120)
	stse_handler.device_type = STSAFE_A120;
#endif

	ret = stse_init(&stse_handler);
	if (ret != STSE_OK) {
		printk("Failed to initialize STSafe handler: %d\n", ret);
		return -1;
	}

	char buffer[] = {1, 2, 3, 4};
	char buffer_out[sizeof(buffer)] = {0};
	ret = stse_device_echo(&stse_handler, (uint8_t *)buffer, (uint8_t *)buffer_out,
			       sizeof(buffer));
	if (ret != STSE_OK) {
		printk("Echo command failed: %d\n", ret);
		return -1;
	}
	if (memcmp(buffer, buffer_out, sizeof(buffer)) != 0) {
		printk("Echo response does not match input data\n");
		return -1;
	}
	printk("Echo command successful\n");
{%- endif %}

	while (1) {
		printk("Alive\n");
		k_sleep(K_MSEC(1000));
	}

	return 0;
}
```

## include/stse_conf.h
```c
/*
 * Copyright (c) {{cookiecutter.copyright_year}}, {{cookiecutter.copyright_holder}}
 * SPDX-License-Identifier: Apache-2.0
 */

#ifndef STSE_CONF_H
#define STSE_CONF_H

#include <zephyr/device.h>
#include <zephyr/drivers/gpio.h>

#define STSE_CONF_STSAFE_A_SUPPORT

#define STSE_USE_RSP_POLLING
#define STSE_MAX_POLLING_RETRY      10
#define STSE_FIRST_POLLING_INTERVAL 33
#define STSE_POLLING_RETRY_INTERVAL 100

#define ZEPHYR_USER_NODE DT_PATH(zephyr_user)
extern const struct gpio_dt_spec stsafe_reset;

#endif /* STSE_CONF_H */
```
