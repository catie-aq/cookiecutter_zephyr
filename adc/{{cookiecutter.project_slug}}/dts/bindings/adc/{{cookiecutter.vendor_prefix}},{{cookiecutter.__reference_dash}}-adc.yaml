## adc/{{cookiecutter.project_slug}}/dts/bindings/adc/{{cookiecutter.vendor_prefix}},{{cookiecutter.__reference_dash}}-adc.yaml
```yaml
# Copyright (c) {{cookiecutter.copyright_year}} {{cookiecutter.copyright_holder}}
# SPDX-License-Identifier: Apache-2.0

description: |
    {{cookiecutter.description}}

compatible: "{{cookiecutter.vendor_prefix}},{{cookiecutter.__reference_dash}}-adc"

{% if cookiecutter.bus == "I2C" -%}
include: [adc-controller.yaml, i2c-device.yaml]
{% elif cookiecutter.bus == "SPI" -%}
include: [adc-controller.yaml, spi-device.yaml]
{% elif cookiecutter.bus == "SERIAL" -%}
include: [adc-controller.yaml, uart-device.yaml]
{% endif -%}
```

## adc/{{cookiecutter.project_slug}}/samples/sample.yaml
```yaml
sample:
  name: {{cookiecutter.reference}} {{cookiecutter.sensor_type}} sensor sample
common:
  tags:
    - adc

tests:
  sample.default:
    integration_platforms:
      - zest_core_stm32l4a6rg
    depends_on:
{% if cookiecutter.bus == "I2C" %}      - i2c
{% elif cookiecutter.bus == "SPI" %}      - spi
{% elif cookiecutter.bus == "uart" %}      - uart
{% endif %}      - YOUR_TAG_HERE
    extra_args: "DTC_OVERLAY_FILE=sixtron_bus.overlay"
```

## core/{{cookiecutter.project_slug}}/boards/{{cookiecutter.__board_vendor_lower}}/{{cookiecutter.__board_name_lower}}/board.yml
```yaml
board:
  name: {{cookiecutter.__board_name_lower_underscore}}
  vendor: {{cookiecutter.__board_vendor_lower}}
  socs:
    - name: {{cookiecutter.__zephyr_board_soc_lower}}
  revision:
    format: "major.minor.patch"
    default: "{{cookiecutter.board_default_version}}"
    exact: true
    revisions:
      - name: "{{cookiecutter.board_default_version}}"
```

## core/{{cookiecutter.project_slug}}/boards/{{cookiecutter.board_arch}}/{{cookiecutter.project_slug}}/Kconfig.board
```kconfig
# Copyright (c) {{cookiecutter.copyright_year}} {{cookiecutter.copyright_holder}}
# SPDX-License-Identifier: Apache-2.0

config BOARD_ZEST_CORE_STM32L4A6RG
	bool "Zest Core STM32L4A6RG Development Board"
	depends on SOC_STM32L4A6XX
```

## core/{{cookiecutter.project_slug}}/boards/{{cookiecutter.board_soc_arch}}/{{cookiecutter.__board_name_lower}}/Kconfig.board
```kconfig
# Copyright (c) {{cookiecutter.copyright_year}} {{cookiecutter.copyright_holder}}
# SPDX-License-Identifier: Apache-2.0

config BOARD_{{cookiecutter.__board_name_upper_underscore}}
	bool "{{cookiecutter.board_name}} Development Board"
	depends on SOC_{{cookiecutter.zephyr_board_soc}}
```

## core/{{cookiecutter.project_slug}}/boards/{{cookiecutter.board_soc_arch}}/{{cookiecutter.__board_name_lower}}/Kconfig.defconfig
```kconfig
# Copyright (c) {{cookiecutter.copyright_year}} {{cookiecutter.copyright_holder}}
# SPDX-License-Identifier: Apache-2.0

if BOARD_ZEST_CORE_STM32L4A6RG

config BOARD
	default "zest_core_stm32l4a6rg"

endif # BOARD_ZEST_CORE_STM32L4A6RG
```

## core/{{cookiecutter.project_slug}}/boards/{{cookiecutter.board_soc_arch}}/{{cookiecutter.__board_name_lower}}/{{cookiecutter.__board_name_lower}}_defconfig
```kconfig
# Copyright (c) {{cookiecutter.copyright_year}} {{cookiecutter.copyright_holder}}
# SPDX-License-Identifier: Apache-2.0

CONFIG_SOC_SERIES_{{cookiecutter.zephyr_board_soc_serie}}=y
CONFIG_SOC_{{cookiecutter.zephyr_board_soc}}=y

# enable uart driver
CONFIG_SERIAL=y

# enable GPIO
CONFIG_GPIO=y

# Enable Clocks
CONFIG_CLOCK_CONTROL=y

# console
CONFIG_CONSOLE=y
CONFIG_UART_CONSOLE=y

# enable MPU
CONFIG_ARM_MPU=y

# enable pin controller
CONFIG_PINCTRL=y
```

## sensor/{{cookiecutter.project_slug}}/drivers/sensor/Kconfig
```kconfig
# Copyright (c) {{cookiecutter.copyright_year}} {{cookiecutter.copyright_holder}}
# SPDX-License-Identifier: Apache-2.0

if SENSOR

rsource "{{cookiecutter.__reference}}"

endif # SENSOR
```

## sensor/{{cookiecutter.project_slug}}/drivers/sensor/{{cookiecutter.vendor_prefix}}/Kconfig
```kconfig
# Copyright (c) {{cookiecutter.copyright_year}} {{cookiecutter.copyright_holder}}
# SPDX-License-Identifier: Apache-2.0

rsource "{{cookiecutter.__reference_snake}}/Kconfig"
```

## sensor/{{cookiecutter.project_slug}}/dts/bindings/sensor/{{cookiecutter.short_manufacturer_lower}},{{cookiecutter.__reference_dash}}.yaml
```yaml
# Copyright (c) {{cookiecutter.copyright_year}} {{cookiecutter.copyright_holder}}
# SPDX-License-Identifier: Apache-2.0

description: |
    {{cookiecutter.manufacturer}} {{cookiecutter.__reference}} {{cookiecutter.description.lower()}}.

compatible: "{{cookiecutter.short_manufacturer.lower()}},{{cookiecutter.__reference_dash}}"

include: [sensor-device.yaml]
```

## sensor/{{cookiecutter.project_slug}}/dts/bindings/sensor/{{cookiecutter.vendor_prefix}},{{cookiecutter.__reference_dash}}.yaml
```yaml
# Copyright (c) {{cookiecutter.copyright_year}} {{cookiecutter.copyright_holder}}
# SPDX-License-Identifier: Apache-2.0

description: |
    {{cookiecutter.description}}

compatible: "{{cookiecutter.vendor_prefix}},{{cookiecutter.__reference_dash}}"

{% if cookiecutter.bus == "I2C" -%}
include: [sensor-device.yaml, i2c-device.yaml]
{% elif cookiecutter.bus == "SPI" -%}
include: [sensor-device.yaml, spi-device.yaml]
{% elif cookiecutter.bus == "SERIAL" -%}
include: [sensor-device.yaml, uart-device.yaml]
{% else -%}
include: [sensor-device.yaml]
{% endif -%}
```

## sensor/{{cookiecutter.project_slug}}/samples/sample.yaml
```yaml
sample:
  name: {{cookiecutter.reference}} {{cookiecutter.sensor_type}} sensor sample
tests:
  sample.default:
    tags: sensor
    integration_platforms:
      - zest_core_stm32l4a6rg
    depends_on:
{% if cookiecutter.bus == "I2C" %}      - i2c
{% elif cookiecutter.bus == "SPI" %}      - spi
{% elif cookiecutter.bus == "uart" %}      - uart
{% endif %}      - YOUR_TAG_HERE
    extra_args: "DTC_OVERLAY_FILE=sixtron_bus.overlay"
```

## sensor/{{cookiecutter.short_manufacturer.lower()}}-{{cookiecutter.reference}}/drivers/Kconfig
```kconfig
# Copyright (c) {{cookiecutter.copyright_year}} {{cookiecutter.copyright_holder}}
# SPDX-License-Identifier: Apache-2.0

menu "Device Drivers"

rsource "sensor/Kconfig"

endmenu
```

## sensor/{{cookiecutter.short_manufacturer.lower()}}-{{cookiecutter.reference}}/dts/bindings/sensor/{{cookiecutter.short_manufacturer.lower()}},{{cookiecutter.reference.lower()}}.yaml
```yaml
# Copyright (c) {{cookiecutter.copyright_year}} {{cookiecutter.copyright_holder}}
# SPDX-License-Identifier: Apache-2.0

description: |
    {{cookiecutter.manufacturer}} {{cookiecutter.reference.lower()}} {{cookiecutter.description.lower()}}.

compatible: "{{cookiecutter.short_manufacturer.lower()}},{{cookiecutter.reference.lower()}}"

include: [sensor-device.yaml]
```

## shield/{{cookiecutter.project_slug}}/boards/shields/{{cookiecutter.project_slug}}/Kconfig.shield
```kconfig
# Copyright (c) {{cookiecutter.copyright_year}} {{cookiecutter.copyright_holder}}
# SPDX-License-Identifier: Apache-2.0

config SHIELD_{{cookiecutter.project_slug|upper}}
	def_bool $(shields_list_contains,{{cookiecutter.project_slug|lower}})

config SHIELD_{{cookiecutter.project_slug|upper}}_ALT
	def_bool $(shields_list_contains,{{cookiecutter.project_slug|lower}}_alt)
```

## workspace_application/{{cookiecutter.project_slug}}/west.yml
```yaml
# Copyright (c) {{cookiecutter.copyright_year}} {{cookiecutter.copyright_holder}}
# SPDX-License-Identifier: Apache-2.0

manifest:
  self:
    path: 6tron-project

  remotes:
    - name: zephyrproject-rtos
      url-base: https://github.com/zephyrproject-rtos
    - name: catie-6tron
      url-base: https://github.com/catie-aq

  projects:
    - name: zephyr
      remote: zephyrproject-rtos
      revision: v4.0.0
      import:
        name-blocklist:
          - hal_altera
          - hal_ambiq
          - hal_atmel
          - hal_espressif
          - hal_ethos_u
          - hal_gigadevice
          - hal_infineon
          - hal_intel
          - hal_microchip
          - hal_nuvoton
          - hal_nxp
          - hal_openisa
          - hal_quicklogic
          - hal_renesas
          - hal_rpi_pico
          - hal_silabs
          - hal_st
          - hal_telink
          - hal_ti
          - hal_wurthelektronik
          - hal_xtensa
    - name: 6tron_manifest
      remote: catie-6tron
      repo-path: zephyr_6tron-manifest
      revision: v4.0.0+202502
      path: 6tron/6tron_manifest
      import: true
```
